## Kconfig
```kconfig
menu "ImGui"

    config IMGUI_PROFILING
        bool "Enable rendering profiling"
        default n
        help
            Instrument the ImGui rendering pipeline to collect per-stage
            timing breakdowns. When enabled, each frame records the time
            spent in ImGui::NewFrame(), ImGui::Render(), buffer clear,
            software rasterization, pixel format conversion, and LCD flush.

            The profiling data is logged to the console once per second
            via imgui_port_enable_profiling_console().

            This adds a small overhead per frame and should only be
            enabled for performance analysis builds.

endmenu
```

## examples/imgui_reload/sdkconfig.defaults
```kconfig
CONFIG_IDF_TARGET="esp32p4"
CONFIG_PARTITION_TABLE_CUSTOM=y
CONFIG_ESPTOOLPY_FLASHSIZE_4MB=y
CONFIG_ESP_TASK_WDT_INIT=n
CONFIG_ESP_SYSTEM_MEMPROT_FEATURE=n

# PSRAM
CONFIG_SPIRAM=y
CONFIG_SPIRAM_MODE_HEX=y
CONFIG_SPIRAM_SPEED_200M=y

# Use newlib instead of picolibc (picolibc.ld breaks hotreload ELF linking)
CONFIG_LIBC_NEWLIB=y

# Networking via internal EMAC (ESP32-P4-Function-EV-Board)
CONFIG_EXAMPLE_CONNECT_ETHERNET=y
CONFIG_EXAMPLE_CONNECT_WIFI=n
```

## examples/imgui_reload_qemu/sdkconfig.defaults
```kconfig
CONFIG_IDF_TARGET="esp32c3"
CONFIG_PARTITION_TABLE_CUSTOM=y
CONFIG_ESPTOOLPY_FLASHSIZE_4MB=y
CONFIG_ESP_TASK_WDT_INIT=n
CONFIG_ESP_INT_WDT=n
CONFIG_ESP_SYSTEM_MEMPROT_FEATURE=n

# QEMU networking: use OpenETH virtual NIC
CONFIG_EXAMPLE_CONNECT_WIFI=n
CONFIG_EXAMPLE_CONNECT_ETHERNET=y
CONFIG_ETH_USE_OPENETH=y
CONFIG_ETHERNET_OPENETH_SUPPORT=y
CONFIG_ETHERNET_INTERNAL_SUPPORT=n
CONFIG_ETHERNET_SPI_SUPPORT=n

# QEMU console: use UART (USB Serial/JTAG not supported)
CONFIG_ESP_CONSOLE_UART_DEFAULT=y

# Use newlib instead of picolibc (picolibc.ld breaks hotreload ELF linking)
CONFIG_LIBC_NEWLIB=y
```

## test_apps/perf/sdkconfig.defaults
```kconfig
CONFIG_IDF_TARGET="esp32p4"
CONFIG_ESP32P4_REV_MIN_300=y
CONFIG_ESPTOOLPY_FLASHSIZE_4MB=y
CONFIG_ESP_TASK_WDT_INIT=n
CONFIG_ESP_MAIN_TASK_STACK_SIZE=16384

# PSRAM
CONFIG_SPIRAM=y
CONFIG_SPIRAM_MODE_HEX=y
CONFIG_SPIRAM_SPEED_200M=y

# Profiling
CONFIG_IMGUI_PROFILING=y
```

## test_apps/qemu_test/main/Kconfig.projbuild
```kconfig
menu "ImGui Test Configuration"

    config IMGUI_TEST_LCD_WIDTH
        int "LCD width in pixels"
        default 800

    config IMGUI_TEST_LCD_HEIGHT
        int "LCD height in pixels"
        default 480

endmenu
```
